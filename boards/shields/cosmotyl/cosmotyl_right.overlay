/*
 * Copyright (c) 2020 Pete Johanson
 *
 * SPDX-License-Identifier: MIT
 */

#include "cosmotyl.dtsi"
#include "kscan.dtsi"

&default_transform {
    col-offset = <5>;
};

&right_encoder {
  status = "okay";
};
