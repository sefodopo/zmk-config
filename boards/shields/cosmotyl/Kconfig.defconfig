## boards/shields/cosmotyl/Kconfig.defconfig
```kconfig
if SHIELD_COSMOTYL_DONGLE

config ZMK_KEYBOARD_NAME
    default "Cosmotyl"

config ZMK_SPLIT_ROLE_CENTRAL
    default y

config ZMK_STUDIO
  default n

endif

if SHIELD_COSMOTYL_LEFT || SHIELD_COSMOTYL_RIGHT || SHIELD_COSMOTYL_DONGLE

config ZMK_SPLIT
    default y

endif
```

## boards/shields/cosmotyl/Kconfig.shield
```kconfig
# Copyright (c) 2020 Pete Johanson
# SPDX-License-Identifier: MIT

config SHIELD_COSMOTYL_LEFT
    def_bool $(shields_list_contains,cosmotyl_left)

config SHIELD_COSMOTYL_RIGHT
    def_bool $(shields_list_contains,cosmotyl_right)
```

## config-stm/boards/arm/keyseebee/Kconfig.board
```kconfig
# keeb.io BDN9 board configuration

# Copyright (c) 2020 The ZMK Contributors
# SPDX-License-Identifier: MIT

config BOARD_KEYSEEBEE_LEFT
    bool "keyseebee_left"
    depends on SOC_STM32F072XB

config BOARD_KEYSEEBEE_RIGHT
    bool "keyseebee_right"
    depends on SOC_STM32F072XB
```

## config-stm/boards/arm/keyseebee/Kconfig.defconfig
```kconfig
# keeb.io BDN9 board configuration

# Copyright (c) 2020 The ZMK Contributors
# SPDX-License-Identifier: MIT

if BOARD_KEYSEEBEE_LEFT

config ZMK_KEYBOARD_NAME
    default "Keyseebee"

config ZMK_SPLIT_ROLE_CENTRAL
  default y

endif # BOARD_KEYSEEBEE_LEFT

if BOARD_KEYSEEBEE_LEFT || BOARD_KEYSEEBEE_RIGHT

#config BOARD
#    default "keyseebee"

config ZMK_SPLIT
  default y

config ZMK_SPLIT_SERIAL
  default y

# config ZMK_SPLIT_SERIAL_UART
#   default y

config SERIAL
  default y

endif # BOARD_KEYSEEBEE_LEFT || BOARD_KEYSEEBEE_RIGHT
```

## config-stm/config/west.yml
```yaml
manifest:
  remotes:
    - name: zmkfirmware
      url-base: https://github.com/zmkfirmware
    - name: xudongzheng
      url-base: https://github.com/xudongzheng
  projects:
    - name: zmk
      remote: xudongzheng
      revision: fa721e8b2ce1d3058615d435350ae32bd0f50aec  # split-serial-pr
      import: app/west.yml
    - name: zephyr
      remote: zmkfirmware
      revision: f8e4d15791602c67405c0fd2651167a895939565  # v3.5.0+zmk-fixes
      import:
        name-blocklist:
          - ci-tools
          - hal_altera
          - hal_cypress
          - hal_infineon
          - hal_microchip
          - hal_nxp
          - hal_openisa
          - hal_silabs
          - hal_xtensa
          - hal_st
          - hal_ti
          - loramac-node
          - mcuboot
          - mcumgr
          - net-tools
          - openthread
          - edtt
          - trusted-firmware-m
  self:
    path: config
```

## config/boards/arm/keyseebee/Kconfig.board
```kconfig
# keeb.io BDN9 board configuration

# Copyright (c) 2020 The ZMK Contributors
# SPDX-License-Identifier: MIT

config BOARD_KEYSEEBEE
    bool "Keyseebee rev2"
    depends on SOC_STM32F072XB
```

## config/boards/arm/keyseebee/Kconfig.defconfig
```kconfig
# keeb.io BDN9 board configuration

# Copyright (c) 2020 The ZMK Contributors
# SPDX-License-Identifier: MIT

if BOARD_KEYSEEBEE

config BOARD
    default "keyseebee_rev4"

config ZMK_KEYBOARD_NAME
    default "Keyseebee Rev4"

#config ZMK_RGB_UNDERGLOW
#    select SPI
#    select WS2812_STRIP

endif # BOARD_BDN9
```

## config/boards/shields/joshkeeb/Kconfig.shield
```kconfig
# Copyright (c) 2020 Pete Johanson
# SPDX-License-Identifier: MIT

config SHIELD_JOSHKEEB_LEFT
	def_bool $(shields_list_contains,joshkeeb_left)

config SHIELD_JOSHKEEB_RIGHT
	def_bool $(shields_list_contains,joshkeeb_right)
```

## config/west.yml
```yaml
manifest:
  remotes:
    - name: zmkfirmware
      url-base: https://github.com/zmkfirmware
  projects:
    - name: zmk
      remote: zmkfirmware
      revision: f08b817d604f0e4b6e8abcfb4926f74abdb23d24  # main
      import: app/west.yml
    - name: zephyr
      remote: zmkfirmware
      revision: f8e4d15791602c67405c0fd2651167a895939565  # v3.5.0+zmk-fixes
      import:
        name-blocklist:
          - ci-tools
          - hal_altera
          - hal_cypress
          - hal_infineon
          - hal_microchip
          - hal_nxp
          - hal_openisa
          - hal_silabs
          - hal_xtensa
          - hal_st
          - hal_ti
          - loramac-node
          - mcuboot
          - mcumgr
          - net-tools
          - openthread
          - edtt
          - trusted-firmware-m
  self:
    path: config
```
