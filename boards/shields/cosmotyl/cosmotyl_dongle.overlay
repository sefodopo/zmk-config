#include <dt-bindings/zmk/matrix_transform.h>
#include "cosmotyl.dtsi"

/ {
  chosen {
    zmk,physical-layout = &default_layout;
  };

  mock_kscan: mock_kscan_0 {
    compatible = "zmk,kscan-mock";
    columns = <0>;
    rows = <0>;
    events = <0>;
  };
};

&default_layout {
  kscan = <&mock_kscan>;
};
